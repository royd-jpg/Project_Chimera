## fs/susfs/Kconfig
```kconfig
# SPDX-License-Identifier: GPL-2.0
# SUSFS Kconfig for the KernelSU-Next kernel-4.9 integration.

menu "KernelSU SUSFS"

config KSU_SUSFS
	bool "KernelSU SUSFS support"
	depends on KSU
	default y
	help
	  Enable the SUSFS hooks prepatched into this kernel tree.

config KSU_SUSFS_SUS_PATH
	bool "SUS path hiding"
	depends on KSU_SUSFS
	default y

config KSU_SUSFS_SUS_MOUNT
	bool "SUS mount hiding"
	depends on KSU_SUSFS
	default y

config KSU_SUSFS_AUTO_ADD_SUS_BIND_MOUNT
	bool "Auto add SUS bind mounts"
	depends on KSU_SUSFS_SUS_MOUNT
	default y

config KSU_SUSFS_AUTO_ADD_TRY_UMOUNT_FOR_BIND_MOUNT
	bool "Auto try-umount bind mounts"
	depends on KSU_SUSFS_SUS_MOUNT && KSU_SUSFS_TRY_UMOUNT
	default y

config KSU_SUSFS_SUS_KSTAT
	bool "SUS kstat spoofing"
	depends on KSU_SUSFS
	default y

config KSU_SUSFS_SUS_MAP
	bool "SUS /proc map hiding"
	depends on KSU_SUSFS
	default y

config KSU_SUSFS_TRY_UMOUNT
	bool "SUSFS try-umount support"
	depends on KSU_SUSFS
	default y

config KSU_SUSFS_AUTO_ADD_SUS_KSU_DEFAULT_MOUNT
	bool "Auto add KernelSU default mounts"
	depends on KSU_SUSFS_SUS_MOUNT
	default y

config KSU_SUSFS_SPOOF_UNAME
	bool "Spoof uname"
	depends on KSU_SUSFS
	default y

config KSU_SUSFS_ENABLE_LOG
	bool "Enable SUSFS logging"
	depends on KSU_SUSFS
	default n

config KSU_SUSFS_HIDE_KSU_SUSFS_SYMBOLS
	bool "Hide KernelSU/SUSFS symbols"
	depends on KSU_SUSFS
	default y

config KSU_SUSFS_SPOOF_CMDLINE_OR_BOOTCONFIG
	bool "Spoof cmdline or bootconfig"
	depends on KSU_SUSFS
	default y

config KSU_SUSFS_OPEN_REDIRECT
	bool "Open redirect support"
	depends on KSU_SUSFS
	default y

endmenu
```
